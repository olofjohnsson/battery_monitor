## src/boards/arm/promicro_nrf/Kconfig.board
```kconfig
# Copyright (c) 2024 Nordic Semiconductor ASA
# SPDX-License-Identifier: Apache-2.0

config BOARD_PROMICRO_NRF
	bool "ProMicro nRF"
	depends on SOC_NRF52840_QIAA
```

## src/boards/arm/promicro_nrf/Kconfig.defconfig
```kconfig
# Copyright (c) 2024 Nordic Semiconductor ASA
# SPDX-License-Identifier: Apache-2.0

if BOARD_PROMICRO_NRF

config BOARD
	default "promicro_nrf"

config BT_CTLR
   default BT


endif
```
